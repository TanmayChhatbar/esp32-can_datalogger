VERSION ""

NS_ :

BS_:
BU_:
BO_ 2147485672 OBD_Engine_Speed: 8 Vector__XXX
   SG_ OBD_Engine_Speed : 31|16@0+ (0.25,0) [0|1] "rpm" Vector__XXX

BA_DEF_ BO_ "GenMsgBackgroundColor" STRING ;
BA_DEF_ BO_ "GenMsgForegroundColor" STRING ;
BA_DEF_ BO_ "filterlabeling" INT 0 0;
BA_DEF_DEF_ "GenMsgBackgroundColor" "#ffffff";
BA_DEF_DEF_ "GenMsgForegroundColor" "#000000";
BA_DEF_DEF_ "filterlabeling" 1;
